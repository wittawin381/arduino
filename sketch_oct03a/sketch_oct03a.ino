#include <LedControl.h>
#include "FontLEDClock.h" // Font library

// copied from http://heim.ifi.uio.no/haakoh/avr/a

const int font_count = 80;



unsigned const char PROGMEM myfont[80][5] = {

  {0, 0, 0, 0, 0}, // space

  {0x3f, 0x48, 0x48, 0x48, 0x3f}, // A
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  {0x11, 0x13, 0x15, 0x19, 0x11}, // z

  

  // invader sprites - may still need some tweaking

  {0x0,  0x19, 0x3A, 0x6D, 0x7A}, // top invader left

  {0x7A, 0x6D, 0x3A, 0x19, 0x0} , // top invader right
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  {0x7C, 0x6C, 0x3B, 0x39, 0x18},



 

};



const int bigfont_count = 10;

unsigned const char PROGMEM mybigfont[10][20] = {

   {0x3F,0x7F,0xE0,0xC1,0xC3,0xC7,0xCE,0xFC,0x7F,0x3F,0xF0,0xF8,0xFC,0xCC,0x8C,0xC,0xC,0x3C,0xF8,0xF0} //0

  ,{0x0,0x0,0x30,0x70,0xFF,0xFF,0x0,0x0,0x0,0x0,0x0,0x0,0xC,0xC,0xFC,0xFC,0xC,0xC,0x0,0x0}

  ,{0x30,0x70,0xE0,0xC0,0xC0,0xC1,0xC3,0xE7,0x7E,0x3C,0xC,0x1C,0x3C,0x7C,0xEC,0xCC,0x8C,0xC,0xC,0xC}

  ,{0x30,0x70,0xE0,0xC0,0xC0,0xC3,0xC3,0xE3,0x7F,0x3C,0x30,0x38,0x1C,0xC,0xC,0xC,0xC,0x1C,0xF8,0xF0}

  ,{0x3,0x7,0xE,0x1C,0x38,0x70,0xFF,0xFF,0x0,0x0,0xC0,0xC0,0xC0,0xC0,0xC0,0xC0,0xFC,0xFC,0xC0,0xC0}

  ,{0xFC,0xFC,0xCC,0xCC,0xCC,0xCC,0xCC,0xCE,0xC7,0xC3,0x30,0x38,0x1C,0xC,0xC,0xC,0xC,0x1C,0xF8,0xF0}

  ,{0x3F,0x7F,0xE3,0xC3,0xC3,0xC3,0xC3,0xE3,0x61,0x20,0xF0,0xF8,0x1C,0xC,0xC,0xC,0xC,0x9C,0xF8,0xF0}

  ,{0xC0,0xC0,0xC0,0xC1,0xC3,0xC7,0xCE,0xDC,0xF8,0xF0,0x0,0x0,0x0,0xFC,0xFC,0x0,0x0,0x0,0x0,0x0}

  ,{0x3C,0x7F,0xE7,0xC3,0xC3,0xC3,0xC3,0xE7,0x7F,0x3C,0xF0,0xF8,0x9C,0xC,0xC,0xC,0xC,0x9C,0xF8,0xF0}

  ,{0x3C,0x7E,0xE7,0xC3,0xC3,0xC3,0xC3,0xC3,0x7F,0x3F,0x10,0x18,0x1C,0xC,0xC,0xC,0xC,0x1C,0xF8,0xF0}

};



const int tinyfont_count = 42;

unsigned const int PROGMEM mytinyfont[42][3] = {

  

   //a-z

   {0, 0, 0}   // space!   

  ,{0x1F, 0x14, 0x1F}

  ,{0x1F, 0x15, 0xA}

  ,{0x1F, 0x11, 0x11}

  ,{0x1F, 0x11, 0xE}

  ,{0x1F, 0x15, 0x11}

  ,{0x1F, 0x14, 0x10}

  ,{0x1F, 0x11, 0x17}

  ,{0x1F, 0x4,  0x1F}

  ,{0x11, 0x1F, 0x11}

  ,{0x3,  0x1,  0x1F}

  ,{0x1F, 0x4,  0x1B}

  ,{0x1F, 0x1,  0x1}

  ,{0x1F, 0x8,  0x1F}

  ,{0x1F, 0x10, 0xF}

  ,{0x1F, 0x11, 0x1F}

  ,{0x1F, 0x14, 0x1C}

  ,{0x1C, 0x14, 0x1F}

  ,{0x1F, 0x16, 0x1D}

  ,{0x1D, 0x15, 0x17}

  ,{0x10, 0x1F, 0x10}

  ,{0x1F, 0x1,  0x1F}

  ,{0x1E, 0x1,  0x1E}

  ,{0x1F, 0x2,  0x1F}

  ,{0x1B, 0x4,  0x1B}

  ,{0x1C, 0x7,  0x1C}

  ,{0x13, 0x15, 0x19}

  

  ,{0x01, 0x00, 0x00}  // .

  ,{0x00, 0x0A, 0x00}  // :

  ,{0x18, 0x00, 0x00}  // '

  ,{0x1D, 0x00, 0x00}  // !

  ,{0x10, 0x15, 0x1C}  // ?

  

  ,{0x1F, 0x11, 0x1F}  //0 - 9

  ,{0x00, 0x00, 0x1F}

  ,{0x17, 0x15, 0x1D}

  ,{0x11, 0x15, 0x1F}

  ,{0x1C, 0x4,  0x1F}

  ,{0x1D, 0x15, 0x17}

  ,{0x1F, 0x15, 0x17}

  ,{0x10, 0x10, 0x1F}

  ,{0x1F, 0x15, 0x1F}

  ,{0x1D, 0x15, 0x1F}

};

LedControl lc=LedControl(11,13,10,4);  // DIN,CLK,CS,Number of LED Module
uint8_t intensity = 1;

unsigned long delaytime=50;  // time to updates of the display

void setup() {
  int devices=lc.getDeviceCount();  // find no of LED modules
  //we have to init all devices in a loop
  for(int address=0;address<devices;address++) {  // set up each device 
    lc.shutdown(address,false);
    lc.setIntensity(address,8);
    lc.clearDisplay(address);
  }
}

void test() {
  int devices=lc.getDeviceCount();  // find no of LED modules
  
  for(int row=32;row>=0;row--) {
    for(int col=0;col<8;col++) {
        delay(delaytime);
        plot(row,col,true);
        delay(delaytime);
        plot(row,col,false);
    }
  }  
}

//plot a point on the display
void plot (uint8_t x, uint8_t y, uint8_t value) {

  //select which matrix depending on the x coord
  uint8_t address;
  if (x >= 0 && x <= 7)   { address = 3; }
  if (x >= 8 && x <= 15)  { address = 2; x = x - 8; }
  if (x >= 16 && x <= 23) { address = 1; x = x - 16;}
  if (x >= 24 && x <= 31) { address = 0; x = x - 24;}

  if (value == 1) {
    lc.setLed(address, y, x, true);
  } else {
    lc.setLed(address, y, x, false);
  }
}

//clear screen
void clear_display() {
  for (uint8_t address = 0; address < 4; address++) {
    lc.clearDisplay(address);
  }
}

//fade screen down
void fade_down() {

  //fade from global intensity to 1
  for (uint8_t i = intensity; i > 0; i--) {
    for (uint8_t address = 0; address < 4; address++) {
      lc.setIntensity(address, i);
    }
    delay(30); //change this to change fade down speed
  }

  clear_display(); //clear display completely (off)

  //reset intentsity to global value
  for (uint8_t address = 0; address < 4; address++) {
    lc.setIntensity(address, intensity);
  }
}

void test_all_led(){
    for (uint8_t x = 0; x <= 31; x++) {
      for (uint8_t y = 0; y <= 7; y++) {
        plot(x, y, 1);
        delay(10);
    }
  }
}

void print_tiny_char(uint8_t x, uint8_t y, char c)
{
  uint8_t dots;
  if (c >= 'A' && c <= 'Z' || (c >= 'a' && c <= 'z') ) { c &= 0x1F; }  // A-Z maps to 1-26 
  else if (c >= '0' && c <= '9') { c = (c - '0') + 32; }
  else if (c == ' ') { c = 0;  } // space 
  else if (c == '.') { c = 27; } // full stop 
  else if (c == ':') { c = 28; } // colon 
  else if (c == '\''){ c = 29; } // single quote mark 
  else if (c == '!') { c = 30; } // single quote mark 
  else if (c == '?') { c = 31; } // single quote mark 

  for (uint8_t col = 0; col < 3; col++) {
    dots = pgm_read_byte_near(&mytinyfont[c][col]);
    for (uint8_t row = 0; row < 5; row++) {
      if (dots & (16 >> row))
        plot(x + col, y + row, 1);
      else
        plot(x + col, y + row, 0);
    }
  }
}

void print_normal_char(uint8_t x, uint8_t y, char c)
{

  uint8_t dots;
  if (c >= 'A' && c <= 'Z' ) { c &= 0x1F; }  // A-Z maps to 1-26
  else if (c >= 'a' && c <= 'z') { c = (c - 'a') + 41; }  // A-Z maps to 41-67
  else if (c >= '0' && c <= '9') { c = (c - '0') + 31; }
  else if (c == ' ') { c = 0; } // space
  else if (c == '.') { c = 27; } // full stop
  else if (c == '\'') { c = 28; } // single quote mark
  else if (c == ':') { c = 29; } // clock_mode selector arrow
  else if (c == '>') { c = 30; } // clock_mode selector arrow
  else if (c >= -80 && c <= -67) { c *= -1; }

  for (uint8_t col = 0; col < 5; col++) {
    dots = pgm_read_byte_near(&myfont[c][col]);
    for (uint8_t row = 0; row < 7; row++) {
      if (dots & (64 >> row)) {   // only 7 rows.
        plot(x + col, y + row, 1);
      } else {
        plot(x + col, y + row, 0);
      }
    }
  }
}

void loop() { 
  
  char hello[6] = "Hello";  
  char world[6] = "World";
  
  uint8_t i = 0;
  while (hello[i]) {
    print_tiny_char((i * 4), 2, hello[i]);
    delay(35);
    i++;
  }
  delay(2000);
  clear_display();
  i=0;
  while (world[i]) {
    print_normal_char((i * 6), 1, world[i]);
    delay(35);
    i++;
  }  
  delay(2000);
  clear_display();  
}
